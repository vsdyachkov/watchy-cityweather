#include "OpenSansCondBoldCyrillic9pt.h"

// Generated from Arial Narrow Bold to match the existing condensed Watchy face style.
// Covers ASCII, Russian Cyrillic, common iOS notification punctuation, and currency signs.
// Currency signs come from Helvetica Neue Condensed Bold because Arial Narrow Bold has tofu glyphs for them.
static const uint8_t OpenSansCondBoldCyrillic9ptBitmaps[] PROGMEM = {
    0x63, 0x18, 0xc6, 0x31, 0x8c, 0x63, 0x00, 0xc6, 0x00, 0x6c, 0xd9, 0xb3, 0x66, 0xc0, 0x00, 0x00,
    0x00, 0x00, 0x00, 0x00, 0x00, 0x36, 0x1b, 0x0d, 0x9f, 0xef, 0xf1, 0xb1, 0xf8, 0xd8, 0xff, 0x7f,
    0x9b, 0x0d, 0x86, 0xc0, 0x08, 0x1c, 0x3e, 0x6b, 0x68, 0x68, 0x78, 0x3e, 0x0f, 0x0b, 0x6b, 0x6b,
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    0x7e, 0x3f, 0x18, 0xcc, 0x66, 0x33, 0x19, 0x9d, 0xfc, 0xfc, 0x30, 0x3e, 0x1f, 0x06, 0x00,
};

static const OpenSansCondensedGlyph OpenSansCondBoldCyrillic9ptGlyphs[] PROGMEM = {
    {0x0020, 0, 0, 0, 0, 0, 4},
    {0x0021, 0, 5, 13, 0, -13, 5},
    {0x0022, 9, 7, 13, 0, -13, 7},
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    {0x2116, 2368, 16, 13, 0, -13, 16},
};

const OpenSansCondensedFont OpenSansCondBoldCyrillic9pt PROGMEM = {
    OpenSansCondBoldCyrillic9ptBitmaps,
    OpenSansCondBoldCyrillic9ptGlyphs,
    static_cast<uint16_t>(sizeof(OpenSansCondBoldCyrillic9ptGlyphs) / sizeof(OpenSansCondBoldCyrillic9ptGlyphs[0])),
    21,
};

namespace
{
uint8_t utf8CharLength(uint8_t leadByte)
{
    if (leadByte < 0x80) { return 1; }
    if ((leadByte & 0xE0) == 0xC0) { return 2; }
    if ((leadByte & 0xF0) == 0xE0) { return 3; }
    if ((leadByte & 0xF8) == 0xF0) { return 4; }
    return 0;
}

bool isUtf8Continuation(uint8_t value)
{
    return (value & 0xC0) == 0x80;
}

bool hasValidUtf8Continuation(const String &text, uint16_t start, uint8_t length)
{
    if (length == 0 || start + length > text.length()) { return false; }
    for (uint8_t offset = 1; offset < length; offset++)
    {
        if (!isUtf8Continuation(static_cast<uint8_t>(text.charAt(start + offset)))) { return false; }
    }
    return true;
}

uint16_t decodeUtf8Codepoint(const String &text, uint16_t index, uint16_t *codepoint)
{
    if (index >= text.length())
    {
        *codepoint = 0;
        return index;
    }
    uint8_t leadByte = static_cast<uint8_t>(text.charAt(index));
    if (leadByte < 0x80)
    {
        *codepoint = leadByte;
        return index + 1;
    }
    uint8_t length = utf8CharLength(leadByte);
    if (!hasValidUtf8Continuation(text, index, length) || length > 3)
    {
        *codepoint = '?';
        return index + 1;
    }
    uint32_t decoded = length == 2 ? leadByte & 0x1F : leadByte & 0x0F;
    for (uint8_t offset = 1; offset < length; offset++)
    {
        decoded = (decoded << 6) | (static_cast<uint8_t>(text.charAt(index + offset)) & 0x3F);
    }
    *codepoint = decoded == 0x00A0 ? ' ' : static_cast<uint16_t>(decoded);
    return index + length;
}

const OpenSansCondensedGlyph *findGlyph(const OpenSansCondensedFont &font, uint16_t codepoint)
{
    int16_t low = 0;
    int16_t high = static_cast<int16_t>(font.glyphCount) - 1;
    while (low <= high)
    {
        int16_t middle = low + (high - low) / 2;
        const OpenSansCondensedGlyph *glyph = &font.glyphs[middle];
        if (glyph->codepoint == codepoint) { return glyph; }
        if (glyph->codepoint < codepoint) { low = middle + 1; }
        else { high = middle - 1; }
    }
    return nullptr;
}
}

namespace OpenSansCondensed
{
String normalize(String text)
{
    String normalized;
    normalized.reserve(text.length());
    bool previousWasSpace = false;
    for (uint16_t index = 0; index < text.length();)
    {
        uint8_t character = static_cast<uint8_t>(text.charAt(index));
        if (character < 32 || character == 127)
        {
            if (!previousWasSpace) { normalized += ' '; }
            previousWasSpace = true;
            index++;
            continue;
        }
        if (character < 0x80)
        {
            if (character == ' ')
            {
                if (!previousWasSpace) { normalized += ' '; }
                previousWasSpace = true;
            }
            else
            {
                normalized += static_cast<char>(character);
                previousWasSpace = false;
            }
            index++;
            continue;
        }
        uint8_t length = utf8CharLength(character);
        if (!hasValidUtf8Continuation(text, index, length))
        {
            if (!previousWasSpace) { normalized += ' '; }
            previousWasSpace = true;
            index++;
        }
        else
        {
            normalized += text.substring(index, index + length);
            previousWasSpace = false;
            index += length;
        }
    }
    normalized.trim();
    return normalized;
}

int16_t textWidth(const OpenSansCondensedFont &font, const String &text)
{
    int16_t width = 0;
    for (uint16_t index = 0; index < text.length();)
    {
        uint16_t codepoint;
        index = decodeUtf8Codepoint(text, index, &codepoint);
        const OpenSansCondensedGlyph *glyph = findGlyph(font, codepoint);
        if (glyph == nullptr) { glyph = findGlyph(font, '?'); }
        if (glyph != nullptr) { width += glyph->xAdvance; }
    }
    return width;
}

void drawText(Adafruit_GFX &display, const OpenSansCondensedFont &font, const String &text, int16_t x, int16_t baselineY, uint16_t color)
{
    int16_t cursorX = x;
    for (uint16_t index = 0; index < text.length();)
    {
        uint16_t codepoint;
        index = decodeUtf8Codepoint(text, index, &codepoint);
        const OpenSansCondensedGlyph *glyph = findGlyph(font, codepoint);
        if (glyph == nullptr) { glyph = findGlyph(font, '?'); }
        if (glyph == nullptr) { continue; }
        uint16_t bitIndex = 0;
        for (uint8_t row = 0; row < glyph->height; row++)
        {
            for (uint8_t column = 0; column < glyph->width; column++)
            {
                uint8_t byte = font.bitmap[glyph->bitmapOffset + bitIndex / 8];
                if ((byte & (0x80 >> (bitIndex & 0x07))) != 0)
                {
                    display.drawPixel(cursorX + glyph->xOffset + column, baselineY + glyph->yOffset + row, color);
                }
                bitIndex++;
            }
        }
        cursorX += glyph->xAdvance;
    }
}

void drawOutlinedText(
    Adafruit_GFX &display,
    const OpenSansCondensedFont &font,
    const String &text,
    int16_t x,
    int16_t baselineY,
    uint16_t textColor,
    uint16_t outlineColor
)
{
    for (int8_t offsetY = -2; offsetY <= 2; offsetY++)
    {
        for (int8_t offsetX = -2; offsetX <= 2; offsetX++)
        {
            if (offsetX == 0 && offsetY == 0) { continue; }
            drawText(display, font, text, x + offsetX, baselineY + offsetY, outlineColor);
        }
    }
    drawText(display, font, text, x, baselineY, textColor);
}

uint16_t fittingUtf8Length(const OpenSansCondensedFont &font, const String &text, int16_t maxWidth)
{
    uint16_t length = 0;
    while (length < text.length())
    {
        uint16_t codepoint;
        uint16_t nextLength = decodeUtf8Codepoint(text, length, &codepoint);
        if (textWidth(font, text.substring(0, nextLength)) > maxWidth) { break; }
        length = nextLength;
    }
    return length;
}

uint16_t wrappedLineLength(const OpenSansCondensedFont &font, const String &text, int16_t maxWidth)
{
    uint16_t length = 0;
    uint16_t lastSpace = 0;
    while (length < text.length())
    {
        uint16_t codepoint;
        uint16_t nextLength = decodeUtf8Codepoint(text, length, &codepoint);
        if (textWidth(font, text.substring(0, nextLength)) > maxWidth) { break; }
        if (codepoint == ' ') { lastSpace = length; }
        length = nextLength;
    }
    if (length == text.length()) { return length; }
    if (lastSpace > 0) { return lastSpace; }
    return fittingUtf8Length(font, text, maxWidth);
}

uint8_t printBlock(Adafruit_GFX &display, const OpenSansCondensedFont &font, String text, int16_t x, int16_t baselineY, int16_t maxWidth, uint8_t maxLines, uint16_t color, bool heavy)
{
    text = normalize(text);
    uint8_t line = 0;
    while (text.length() > 0 && line < maxLines)
    {
        uint16_t length = wrappedLineLength(font, text, maxWidth);
        if (length == 0) { break; }
        String currentLine = text.substring(0, length);
        currentLine.trim();
        int16_t lineBaseline = baselineY + line * font.lineHeight;
        drawText(display, font, currentLine, x, lineBaseline, color);
        if (heavy)
        {
            drawText(display, font, currentLine, x + 1, lineBaseline, color);
        }
        text = text.substring(length);
        text.trim();
        line++;
    }
    return line;
}

void printLine(Adafruit_GFX &display, const OpenSansCondensedFont &font, String text, int16_t x, int16_t baselineY, int16_t maxWidth, bool rightAlign, uint16_t color)
{
    text = normalize(text);
    uint16_t length = fittingUtf8Length(font, text, maxWidth);
    text = text.substring(0, length);
    text.trim();
    if (text.length() == 0) { return; }
    int16_t cursorX = x;
    if (rightAlign) { cursorX = x + maxWidth - textWidth(font, text); }
    drawText(display, font, text, cursorX, baselineY, color);
}

void printCentered(Adafruit_GFX &display, const OpenSansCondensedFont &font, String text, int16_t centerX, int16_t baselineY, int16_t maxWidth, uint16_t color)
{
    text = normalize(text);
    uint16_t length = fittingUtf8Length(font, text, maxWidth);
    text = text.substring(0, length);
    text.trim();
    if (text.length() == 0) { return; }
    int16_t cursorX = centerX - textWidth(font, text) / 2;
    drawText(display, font, text, cursorX, baselineY, color);
}

void printCenteredOutlined(
    Adafruit_GFX &display,
    const OpenSansCondensedFont &font,
    String text,
    int16_t centerX,
    int16_t baselineY,
    int16_t maxWidth,
    uint16_t textColor,
    uint16_t outlineColor
)
{
    text = normalize(text);
    uint16_t length = fittingUtf8Length(font, text, maxWidth);
    text = text.substring(0, length);
    text.trim();
    if (text.length() == 0) { return; }
    int16_t cursorX = centerX - textWidth(font, text) / 2;
    drawOutlinedText(display, font, text, cursorX, baselineY, textColor, outlineColor);
}
}
